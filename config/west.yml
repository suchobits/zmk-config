## config/west.yml
```yaml
manifest:
  defaults:
    revision: v0.3
  remotes:
    - name: zmkfirmware
      url-base: https://github.com/zmkfirmware
    - name: aym1607
      url-base: https://github.com/AYM1607
    - name: suchobits
      url-base: https://github.com/suchobits
    # Additional modules containing boards/shields/custom code can be listed here as well
    # See https://docs.zephyrproject.org/3.2.0/develop/west/manifest.html#projects
  projects:
    - name: zmk
      remote: zmkfirmware
      import: app/west.yml
    - name: zmk-driver-azoteq-iqs5xx
      remote: suchobits
      revision: polling-mode-support
  self:
    path: config
```
